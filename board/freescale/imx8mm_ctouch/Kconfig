## board/freescale/imx8mm_ctouch/Kconfig
```kconfig
if TARGET_IMX8MM_CTOUCH || TARGET_IMX8MM_DDR4_CTOUCH

config SYS_BOARD
	default "imx8mm_ctouch"

config SYS_VENDOR
	default "freescale"

config SYS_CONFIG_NAME
	default "imx8mm_ctouch"

source "board/freescale/common/Kconfig"

endif
```
